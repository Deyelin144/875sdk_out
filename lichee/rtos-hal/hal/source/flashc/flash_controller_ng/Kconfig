## lichee/rtos/projects/Kconfig
```kconfig
choice
    prompt "Configure Application"
    default PROJECT_R328S1_EVB1_DEMO

config PROJECT_R328S1_EVB1
    bool "r328s1 evb1 demo application"
	select PROJECT_R328S1
    ---help---
        the r328s1 application include common components

config PROJECT_R328S1_EVB1_XR819S
    bool "r328s1 evb1 xr819s application"
	select PROJECT_R328S1
    ---help---
        the r328s1 application include common components

config PROJECT_R528S3_EVB3
    bool "r528s3 evb3 demo application"
	select PROJECT_R528S3
    ---help---
        the r528s3 application include common components

config PROJECT_R528S3_EVB3_NAND
    bool "r528s3 evb3 nand demo application"
	select PROJECT_R528S3
    ---help---
        the r528s3 application include common components

config PROJECT_R128S2_MINI_M33
    bool "r128s2 mini m33 system"
	select PROJECT_R128S2
    ---help---
        r128s2 mini m33 system

config PROJECT_R128S2_VER_M33
    bool "r128s2 ver m33 system"
	select PROJECT_R128S2
    ---help---
        r128s2 ver m33 system

config PROJECT_R128S2_WLAN_BT_M33
    bool "r128s2 wlan bt m33 system"
	select PROJECT_R128S2
    ---help---
        r128s2 wlan bt m33 system

config PROJECT_R128S2_EVB1_M33
    bool "r128s2 evb1 m33 system"
	select PROJECT_R128S2
    ---help---
        r128s2 evb1 m33 system

config PROJECT_R128S2_EVB1_C906
    bool "r128s2 evb1 c906 system"
	select PROJECT_R128S2
    ---help---
        r128s2 evb1 c906 system

config PROJECT_R128S2_PRO_M33
    bool "r128s2 pro m33 system"
	select PROJECT_R128S2
    ---help---
        r128s2 pro m33 system

config PROJECT_R128S2_PRO_C906
    bool "r128s2 pro c906 system"
	select PROJECT_R128S2
    ---help---
        r128s2 pro c906 system

config PROJECT_R128S1_PRO_M33
    bool "r128s1 pro m33 system"
	select PROJECT_R128S1
    ---help---
        r128s1 pro m33 system

config PROJECT_R128S1_PRO_C906
    bool "r128s1 pro c906 system"
	select PROJECT_R128S1
    ---help---
        r128s1 pro c906 system

config PROJECT_R128S3_EVB1_M33
    bool "r128s3 evb1 m33 system"
	select PROJECT_R128S3
    ---help---
        r128s3 evb1 m33 system

config PROJECT_R128S3_EVB1_C906
    bool "r128s3 evb1 c906 system"
	select PROJECT_R128S3
    ---help---
        r128s3 evb1 c906 system

config PROJECT_R128S3_PRO_M33
    bool "r128s3 pro m33 system"
	select PROJECT_R128S3
    ---help---
        r128s3 pro m33 system

config PROJECT_R128S3_PRO_C906
    bool "r128s3 pro c906 system"
	select PROJECT_R128S3
    ---help---
        r128s3 pro c906 system

config PROJECT_R128S3_PRO_RGB_M33
    bool "r128s3 pro rgb m33 system"
	select PROJECT_R128S3
    ---help---
        r128s3 pro rgb nand m33 system

config PROJECT_R128S3_MINI_M33
    bool "r128s3 mini m33 system"
	select PROJECT_R128S3
    ---help---
        r128s3 mini m33 system

config PROJECT_R128S3_PRO_RGB_C906
    bool "r128s3 pro rgb c906 system"
	select PROJECT_R128S3
    ---help---
        r128s3 pro rgb nand c906 system

config PROJECT_R128S3_EVB1_NAND_M33
    bool "r128s3 nand evb1 m33 system"
	select PROJECT_R128S3
    ---help---
        r128s3 nand evb1 m33 system

config PROJECT_R128S3_EVB1_NAND_C906
    bool "r128s3 nand evb1 c906 system"
	select PROJECT_R128S3
    ---help---
        r128s3 nand evb1 c906 system

config PROJECT_XR875_EVB1_M33
    bool "xr875 evb1 m33 system"
	select PROJECT_XR875
    ---help---
        xr875 evb1 m33 system

config PROJECT_XR875_EVB1_C906
    bool "xr875 evb1 C906 system"
	select PROJECT_XR875
    ---help---
        xr875 evb1 C906 system

config PROJECT_XR875_MINI_M33
    bool "xr875 mini m33 system"
	select PROJECT_XR875
    ---help---
        xr875 m33 mini system

config PROJECT_XR875S1_PRO_HP_M33
    bool "xr875s1 pro m33 hpsram system"
	select PROJECT_XR875S1
    ---help---
        xr875s1 pro m33 hpsram system

config PROJECT_XR875S1_PRO_HP_C906
    bool "xr875s1 pro c906 hpsram system"
	select PROJECT_XR875S1
    ---help---
        xr875s1 pro C906 hpsram system

config PROJECT_A523_E906_MINI
    bool "a523 e906 min system"
	select PROJECT_A523_E906
    ---help---
        a523 e906 min system

config PROJECT_XR875_EVB1_NAND_M33
    bool "xr875 nand evb1 m33 system"
	select PROJECT_XR875
    ---help---
        xr875 nand evb1 m33 system

config PROJECT_XR875S1H10_PRO_M33
    bool "xr875s1h10 pro m33 system"
	select PROJECT_XR875S1H10
    ---help---
        xr875s1h10 pro m33 system

config PROJECT_XR875S1H10_PRO_C906
    bool "xr875s1h10 pro c906 system"
	select PROJECT_XR875S1H10
    ---help---
        xr875s1h10 pro c906 system

config PROJECT_SOLUTION_M33
    bool "solution m33 system"
	select PROJECT_XR875S1H10
    ---help---
        solution pro m33 system

config PROJECT_SOLUTION_C906
    bool "solution c906 system"
	select PROJECT_XR875S1H10
    ---help---
        solution c906 system

endchoice

config PROJECT_R128S2
    bool

config PROJECT_R128S1
    bool

config PROJECT_R128S3
    bool

config PROJECT_XR875
    bool

config PROJECT_XR875S1
    bool

config PROJECT_XR875S1H10
    bool


if PROJECT_R128S2_PRO_M33
source projects/r128s2/pro_m33/Kconfig
endif

if PROJECT_XR875S1_PRO_HP_M33
source projects/xr875s1/pro_hp_m33/Kconfig
endif

if PROJECT_XR875S1H10_PRO_M33
source projects/xr875s1h10/pro_m33/Kconfig
endif

if PROJECT_SOLUTION_M33
source projects/xr875s1h10/solution_m33/Kconfig
endif


config PROJECT_TESTCASE
    bool "Project Testcase"
    default n
```
