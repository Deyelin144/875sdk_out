## lichee/rtos-hal/hal/source/spinor/spi_nor_ng/Kconfig
```kconfig
menu "SPI NOR Flash Devices(Next Generation)"
visible if !DRIVERS_SPINOR && DRIVERS_SNOR_FLASHC_NG

config DRIVERS_SPI_NOR_NG
	bool "Enable Allwinner SPI NOR Flash Driver(Next Generation)"
	default n

if DRIVERS_SPI_NOR_NG

config MAX_SPI_NOR_FLASH_NUM
	int "Supported SPI NOR Flash num"
	default 1

config READ_SFDP_CLK_FREQ
	int "Clock frequency when read SFDP"
	range 1000000 50000000
	default 50000000
	help
		JESD216 spec require the flash must support to read SFDP
		at 50MHz condition.

config SPI_NOR_RW_CLK_FREQ
	int "Clock frequency when read or write flash"
	range 1000000 100000000
	default 100000000
	depends on !USE_SPI_NOR_ON_AMP || SNOR_ON_AMP_BOOT_CPU
	help
		This parameter depends on specific SPI NOR flash hardware.

config DRIVERS_SPINOR_PANIC_WRITE
	bool
	default n

config USE_SPI_NOR_ON_AMP
	bool "Use SPI NOR flash on AMP"
	select USE_FLASH_CONTROLLER_ON_AMP
	default n
	help
		support to use SPI NOR flash on AMP

choice
prompt "Current CPU role"
depends on USE_SPI_NOR_ON_AMP
default SNOR_ON_AMP_BOOT_CPU

config SNOR_ON_AMP_BOOT_CPU
	bool "boot CPU"
	select FC_ON_AMP_BOOT_CPU

config SNOR_ON_AMP_NON_BOOT_CPU
	bool "non-boot CPU"
	select FC_ON_AMP_NON_BOOT_CPU

endchoice

config ACCESS_SPI_NOR_BY_BLKPART
	bool "Access SPI NOR flash by blkpart"
	depends on COMPONENTS_AW_BLKPART
	default n

config XIP
	bool "Enable SPI NOR flash XIP"
	depends on DRIVERS_SNOR_FLASHC_NG
	default y

if XIP
config XIP_NEED_INIT
	bool
	depends on !USE_SPI_NOR_ON_AMP || SNOR_ON_AMP_BOOT_CPU
	select COMPONENTS_AW_BLKPART
	select COMPONENT_ENV
	select READ_ENV_IN_EARLY_STAGE
	default y

config XIP_CFG_ENV_NAME
	string "XIP configuration environment variable name"
	depends on !USE_SPI_NOR_ON_AMP || SNOR_ON_AMP_BOOT_CPU
	default "xip_partition"

config XIP_MEM_START_ADDR
	hex "XIP memory start addr"
	default "0x10000000"

config XIP_MEM_LEN
	hex "XIP memory length"
	default "0x800000"

config SECTION_ATTRIBUTE_XIP
	bool "support xip_text section"
	depends on XIP
	default y

config SECTION_ATTRIBUTE_NONXIP
	bool "support nonxip_text section"
	depends on XIP
	default y

config SECTION_ATTRIBUTE_SRAM
	bool "support sram_text section"
	depends on XIP
	default y

endif

endif

endmenu
```

## lichee/rtos/arch/arm/armv8m/sun20iw2p1/Kconfig
```kconfig
if ARCH_SUN20IW2P1

config POWER_FALL_PROTECTION
	bool "power fail protection"
	default n
	help
		When vbat drops to 2.7V, SoC will reset to prevent the system working
		in the wrong voltage.

config USE_EXTERNAL_LOW_FREQ_CRYSTAL_CLK
	bool "Use the external low frequency crystal clock"
	default n
	help
		Use the external low frequency crystal clock. After enable this config,
		the clock source of sys_32k, sysrtc_32k and ble_32k will be
		the external low frequency crystal.

config WAIT_RTC_COUNTER_WHEN_SWITCH_RTC_CLK_SRC
	bool "Wait RTC counter when switch RTC module clock source"
	default n
	help
		Wait the value of RTC second counter to increase 1 when switch RTC module
		clock source to a clock whose frequency is lower than previous clock. If we
		don't immediately switch clock source after the value of RTC second counter
		increase 1, the RTC time will jump and automatically recover after 31s.
		This configuration is used to fix RTC time jump issue and will add about
		maximal 1s elapsed time. If you need to use RTC, you should enable it.

menuconfig DEFAULT_USE_EXTERNAL_SUPPLY
	bool "default swtich supply to external supply"
	default n
	help
		swtich DCDC supply to external supply or lower the voltage of the APP_LDO/DSP_LDO.

if DEFAULT_USE_EXTERNAL_SUPPLY
config EXTERNAL_DCDC_EN_IO_PA_X
	int "external DCDC en io PAX"
	default 11
	help
		external DCDC en io PAXX in the Schematic.

config LOWER_APP_LDO_TO_1_0V
	bool "APP_LDO to 1.0V"
	default n
	help
		lower the voltage of the APP_LDO to 1.0V.

config LOWER_DSP_LDO_TO_1_0V
	bool "DSP_LDO to 1.0V"
	default n
	help
		lower the voltage of the DSP_LDO to 1.0V.

config CLOSE_INTERNAL_DCDC
	bool "close internal DCDC"
	default n
	help
		close internal DCDC.
endif

config AR200A_HIGH_FREQ
	bool "M33 start at 240M by default"
	default n
	help
		Say y here to support VF point: M33 240M@1.2V

endif

config DSP_IS_POWERED_BY_INTERNAL_LDO
	bool "dsp is powered by internal ldo"
	depends on !DEFAULT_USE_EXTERNAL_SUPPLY
	default n
	help
		Configuring the DSP_LDO at a voltage suitable for DSP.
```

## lichee/rtos/components/aw/Kconfig
```kconfig
source components/aw/smartlink/Kconfig

source components/aw/devfs/Kconfig

source components/aw/blkpart/Kconfig

source components/aw/multimedia/Kconfig

source components/aw/secure_storage/Kconfig

source components/aw/bluetooth/Kconfig

source components/aw/watchpoint/Kconfig

source components/aw/memleak/Kconfig

source components/aw/newlibc/Kconfig

source components/aw/tfm/Kconfig

source components/aw/healthd/Kconfig

source components/aw/camera_preview/Kconfig

source components/aw/flag/Kconfig

source components/aw/pstore/Kconfig

source components/aw/kasan/Kconfig
```

## lichee/rtos/components/aw/bluetooth/Kconfig
```kconfig
menu "aw bluetooth"

config AW_COMPONENT_ETF
    bool "etf"
    default n
    help
      support etf test.

config AW_COMPONENT_BLUEDROID_CTRL
    bool "bluedroid ctrl"
    default n
    help
      support bluedroid ctrl test.

config AW_COMPONENT_XBTC_UART
    bool "bluetooth uart"
    default n
    help
      support bluetooth uart control.

config AW_COMPONENT_VS
    bool "vendor"
    default n
    help
      This option enables vendor support.

#if ZEPHYR_BLE

#source "components/aw/bluetooth/zephyr/Kconfig"

#endif

endmenu
```

## lichee/rtos/components/aw/flag/Kconfig
```kconfig
menuconfig COMPONENT_FLAG
    bool "flag"
    select COMPONENTS_AW_BLKPART
    default n
    help
      support read write env
      If unsure, say Y.

if COMPONENT_FLAG

    config COMPONENTS_ENV_SIZE
    int "env Size (bytes)"
    default 4096
    help
        Size of env in bytes.

    config COMPONENTS_FLAG_PRINTENV
    bool "print env"
    default y
    help
        print env.

    config COMPONENTS_FLAG_SETENV
    bool "set env"
    default y
    help
        set env.

    config COMPONENTS_FLAG_FILE_SUPPORT
    bool "support file operations"
    default y
    help
        support standard open,read,write.

    config READ_ENV_IN_EARLY_STAGE
    bool "support read env in early stage"
	default n

endif
```

## lichee/rtos/components/aw/multimedia/Kconfig
```kconfig
menu "aw multimedia"
config LIB_MULTIMEDIA
	bool "support cedarx player"
	default n

config LIB_RECORDER
	bool "support cedarx recorder"
	default n

config LIB_MULTIMEDIA_CROP
    bool "support cedarx customization"
    depends on (LIB_MULTIMEDIA || LIB_RECORDER)
    default n

menu "multimedia demo"
config RTPLAYER_TEST
#    select COMPONENTS_AW_ALSA_LIB
#    select COMPONENT_VFS
#    select COMPONENTS_TCPIP
    select COMPONENTS_LWIP
    select COMPONENTS_MBEDTLS
	select LIB_MULTIMEDIA
	depends on DRIVERS_SOUND || DRIVERS_SOUND_V2
	bool "test rtplayer demo"
    default n

config RTPLAYER_DIRPLAY
    bool "rtplayer support dirplay"
    default y
    depends on RTPLAYER_TEST

config TOTAL_AUDIO_NUM
    int "set max num of dir-play supporting"
    depends on RTPLAYER_DIRPLAY
    default 30

config RTRECORDER_TEST
    bool "test cedarx recorder demo"
	select LIB_RECORDER
	depends on DRIVERS_SOUND || DRIVERS_SOUND_V2
    default n

config RTOPUS_TEST
    bool "test opus encode and decode demo"
    default n

config PLAY_FIFO
	bool "rtos multimedia play fifo demo"
	select LIB_MULTIMEDIA
	depends on DRIVERS_SOUND || DRIVERS_SOUND_V2
	default n

config AVI_TEST
    bool "avi play test"
    default n

config MP4_TEST
    bool "mp4 play test"
    default n

config CUSTOMER_STREAM_TEST
    bool "customer stream test"
    default n

endmenu

endmenu
```

## lichee/rtos/components/aw/newlibc/Kconfig
```kconfig
menu "Newlibc Components Support"

config ARCH_MEMCPY_OPTIMIZE
    bool "Tina RTOS Memcpy Optimize"
    default y

config HEAP_TRACE
    bool "heap trace"
    default n

endmenu
```

## lichee/rtos/components/thirdparty/Kconfig
```kconfig
source components/thirdparty/common/Kconfig

source components/thirdparty/console/Kconfig

source components/thirdparty/cplusplus/Kconfig

source components/thirdparty/smartlink/Kconfig

source components/thirdparty/vfs/Kconfig

source components/thirdparty/lfs/Kconfig

source components/thirdparty/elmfat/Kconfig

source components/thirdparty/speex/Kconfig

source components/thirdparty/aispeech_duikit_sdk/Kconfig
```

## lichee/rtos/components/thirdparty/aispeech_duikit_sdk/Kconfig
```kconfig
config COMPONENT_AISPEECH_DUIKIT_SDK
    bool "AIspeech Duikit SDK"
    select DRIVERS_EFUSE
    select CUSTOM_VSPRINTF
    select COMPONENTS_RPDATA
    select COMPONENTS_LWIP
    select COMPONENTS_LWIP_2_1_3
    select COMPONENTS_MBEDTLS
    select COMPONENTS_MBEDTLS_2_16_0
    select COMPONENT_CJSON
    select COMPONENT_SPEEX
    default n
    help
        AIspeech Duikit Rtos SDK.
```

## lichee/rtos/drivers/drv/Kconfig
```kconfig
source drivers/drv/wireless/Kconfig

source drivers/drv/leds/Kconfig

source drivers/drv/input/Kconfig

source drivers/drv/uart/Kconfig

source drivers/drv/bluetooth/Kconfig

source drivers/drv/fdcm/Kconfig
```

## lichee/rtos/drivers/drv/bluetooth/driver/controller/xradio/sun20iw2/Kconfig
```kconfig
choice
	prompt "Sun20iw2 Driver Controller"
	default DRIVER_SUN20IW2_BT_CONTROLLER

config DRIVER_SUN20IW2_BT_CONTROLLER
	bool "Sun20iw2 BT Controller"
	help
	  If this option is enabled, Sun20iw2 BT Controller is used.

config DRIVER_SUN20IW2_BT_CONTROLLER_BLE_ONLY
	bool "Sun20iw2 BLE Only Controller"
	help
	  If this option is enabled, Sun20iw2 BLE only Controller is used.

config DRIVER_SUN20IW2_BT_CONTROLLER_BR_ONLY
	bool "Sun20iw2 BR/EDR Only Controller"
	help
	  If this option is enabled, Sun20iw2 BR/EDR only Controller is used.

endchoice

config BT_HOST_RUN_IN_M33
	bool "host and controller all run in m33"
	default n
	depends on ARCH_ARM_CORTEX_M33
	help
	  If host and controller all run in m33, this option shold enable
```

## lichee/rtos/drivers/drv/input/keyboard/Kconfig
```kconfig
menuconfig DRIVERS_KEYBOARD
	default n
	bool "keyboard driver"

if DRIVERS_KEYBOARD

config DRIVERS_SUNXI_KEYBOARD
    bool "enable sunxi-keyboard drivers"
        default n

config DRIVERS_GPIO_KEY_POLLED
    bool "enable gpio key polled drivers"
        default n

config DRIVERS_GPADC_KEY
    bool "enable gpadc key drivers"
	default n

config DRIVERS_GPIO_KEY_NORMAL
    bool "enable gpio key normal drivers"
        default n

config NORMAL_KEY_TEST
    bool "key normal drivers test"
    default n
    depends on DRIVERS_GPIO_KEY_NORMAL

endif
```

## lichee/rtos/drivers/drv/wireless/Kconfig
```kconfig
menuconfig DRIVERS_WIRELESS
	default n
	bool "wireless devices"

if DRIVERS_WIRELESS

source drivers/drv/wireless/xradio/Kconfig

endif #DRIVERS_WIRELESS
```
