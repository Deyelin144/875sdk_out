## lichee/rtos-hal/hal/source/flashc/flash_controller_ng/Kconfig
```kconfig
menu "SPI NOR Flash Controller Devices(Next Generation)"
visible if !DRIVERS_FLASHC

config DRIVERS_SNOR_FLASHC_NG
    bool "Enable Allwinner SPI NOR Flash Controller Driver(Next Generation)"
	default n

if DRIVERS_SNOR_FLASHC_NG

menu "Flash Controller Sample Delay(unit: half clock cycle)"
	depends on !USE_FLASH_CONTROLLER_ON_AMP || FC_ON_AMP_BOOT_CPU

config FC_SAMPLE_DELAY_0_MAX_CLK_FREQ
	int "Maximal clock frequency(included) when add 0 sample delay"
    default 40000000
	help
		When we read data from flash and after the address or dummy
		data has been sended by controller, due to the signal delay
		in hardware level, it will need some delay to sample correct
		data. And the delay value is not same when we use different
		hardware or use different clock frequency.

config FC_SAMPLE_DELAY_1_MAX_CLK_FREQ
	int "Maximal clock frequency(included) when add 1 sample delay"
    default 64000000
	help
		When we read data from flash and after the address or dummy
		data has been sended by controller, due to the signal delay
		in hardware level, it will need some delay to sample correct
		data. And the delay value is not same when we use different
		hardware or use different clock frequency.

config FC_SAMPLE_DELAY_2_MAX_CLK_FREQ
	int "Maximal clock frequency(included) when add 2 sample delay"
    default 144000000
	help
		When we read data from flash and after the address or dummy
		data has been sended by controller, due to the signal delay
		in hardware level, it will need some delay to sample correct
		data. And the delay value is not same when we use different
		hardware or use different clock frequency.

endmenu

config DISABLE_INTERRUPT_WHEN_USING_INDIRECT_MODE
	bool "disable global interrupt when using indirect mode"
	default n
	help
		In order to prevent the CPU execute code which is saved in
		SPI NOR flash(it's also called XIP) when using indirect mode
		to access flash, We need to suspend scheduler. But when the
		interrupt handler or code which is called by interrupt handler
		is saved in flash, we need to disable global interrupt.

config USE_FLASH_CONTROLLER_ON_AMP
	bool "Use flash controller on AMP"
	depends on USE_SPI_NOR_ON_AMP
	default n
	help
		support to use SPI NOR flash controller on AMP

config FC_ON_AMP_BOOT_CPU
    bool "boot CPU"
	depends on USE_FLASH_CONTROLLER_ON_AMP && SNOR_ON_AMP_BOOT_CPU

config FC_ON_AMP_NON_BOOT_CPU
	bool "non-boot CPU"
	depends on USE_FLASH_CONTROLLER_ON_AMP && SNOR_ON_AMP_NON_BOOT_CPU

endif

endmenu
```

## lichee/rtos-hal/hal/source/rtc/Kconfig
```kconfig
menu "RTC Devices"

config DRIVERS_RTC
    bool "enable rtc driver"
        default y

config HAL_TEST_RTC
    bool "enable rtc hal APIs test command"
    depends on DRIVERS_RTC
        default n

config SET_RTC_CHECK
    bool "enable recheck rtc set"
    depends on DRIVERS_RTC
        default n

endmenu
```

## lichee/rtos-hal/hal/source/sound/Kconfig
```kconfig
menu "SOUND Driver"

config DRIVERS_SUNXI_SOUND
	bool "Sound card support"
	default n

choice
	prompt "Allwinner Sound Driver"
	depends on DRIVERS_SUNXI_SOUND
	default AW_SOUND_DRIVER_NONE

config AW_SOUND_DRIVER_NONE
	bool "none"

config AW_SOUND_DRIVER_V2
	bool "Sound Driver V2"
	help
	  This is sound driver v2 for aw, only used for Allwinner FreeRTOS.
endchoice

if AW_SOUND_DRIVER_V2
source "drivers/rtos-hal/hal/source/sound/driver_v2/Kconfig"
endif


endmenu
```

## lichee/rtos-hal/hal/source/sound/driver_v2/Kconfig
```kconfig
menu "SOUND Devices V2"

config DRIVERS_SOUND_V2
	bool "Sound card support"
	depends on AW_SOUND_DRIVER_V2
	default y

if DRIVERS_SOUND_V2

source "drivers/rtos-hal/hal/source/sound/driver_v2/adf/Kconfig"
source "drivers/rtos-hal/hal/source/sound/driver_v2/core/Kconfig"
source "drivers/rtos-hal/hal/source/sound/driver_v2/component/Kconfig"
source "drivers/rtos-hal/hal/source/sound/driver_v2/codecs/Kconfig"
source "drivers/rtos-hal/hal/source/sound/driver_v2/common/Kconfig"
source "drivers/rtos-hal/hal/source/sound/driver_v2/platform/Kconfig"

endif # DRIVERS_SOUND_V2

endmenu
```

## lichee/rtos-hal/hal/source/sound/driver_v2/adf/Kconfig
```kconfig
menu "AllWinner Audio Driver Framework"

config SUNXI_SOUND_AUDIO_DRIVER_FRAMEWORK
	bool "Allwinner Audio Driver Framework support"
	default n
	help
	  Select Y to add support Allwinner Audio Driver Framework.

config SUNXI_SOUND_AUDIO_DRIVER_FRAMEWORK_CORE
	bool "Allwinner Audio Driver Framework Core support"
	default y
	depends on SUNXI_SOUND_AUDIO_DRIVER_FRAMEWORK
	help
	  Select Y to add support Allwinner Audio Driver Framework Core.

config SUNXI_SOUND_AUDIO_DRIVER_FRAMEWORK_COMPONENT
	bool "Allwinner Audio Driver Framework Component support"
	default y
	depends on SUNXI_SOUND_AUDIO_DRIVER_FRAMEWORK_CORE
	help
	  Select Y to add support Allwinner Audio Driver Framework Component.

config SUNXI_SOUND_AUDIO_DRIVER_FRAMEWORK_DAI
	bool "Allwinner Audio Driver Framework Dai support"
	default y
	depends on SUNXI_SOUND_AUDIO_DRIVER_FRAMEWORK_CORE
	help
	  Select Y to add support Allwinner Audio Driver Framework digtal audio interface.

config SUNXI_SOUND_AUDIO_DRIVER_FRAMEWORK_PCM
	bool "Allwinner Audio Driver Framework Pcm support"
	default y
	depends on SUNXI_SOUND_AUDIO_DRIVER_FRAMEWORK_CORE
	help
	  Select Y to add support Allwinner Audio Driver Framework pcm operation interface.

endmenu
```

## lichee/rtos-hal/hal/source/sound/driver_v2/codecs/Kconfig
```kconfig
menu "AllWinner CODEC drivers V2"

config SUNXI_SOUND_CODEC_SUN8IW18_AUDIOCODEC
	bool "Allwinner AudioCodec support"
	default n
	select SUNXI_SOUND_PLATFORM_CPUDAI
	select SUNXI_SOUND_PLATFORM_PCM
	select SUNXI_SOUND_COMMON_SUNXI_COMMON
	depends on (ARCH_SUN8IW18P1 || ARCH_SUN8IW18)
	help
	  Select Y to add support the Codec embedded in the Allwinner
	  sun8iw18 and affiliated SoCs.

config SUNXI_SOUND_CODEC_SUN8IW19_AUDIOCODEC
	bool "Allwinner AudioCodec support"
	default n
	select SUNXI_SOUND_PLATFORM_CPUDAI
	select SUNXI_SOUND_PLATFORM_PCM
	select SUNXI_SOUND_COMMON_SUNXI_COMMON
	depends on (ARCH_SUN8IW19P1 || ARCH_SUN8IW19)
	help
	  Select Y to add support the Codec embedded in the Allwinner
	  sun8iw19 and affiliated SoCs.

config SUNXI_SOUND_CODEC_SUN8IW20_AUDIOCODEC
	bool "Allwinner AudioCodec V2 support"
	default n
	select SUNXI_SOUND_PLATFORM_CPUDAI
	select SUNXI_SOUND_PLATFORM_PCM
	select SUNXI_SOUND_COMMON_SUNXI_COMMON
	depends on (SOC_SUN20IW1P1 || ARCH_SUN8IW20)
	help
	  Select Y to add support the Codec embedded in the Allwinner
	  sun8iw20 and affiliated SoCs.

config SUNXI_SOUND_CODEC_SUN20IW2_AUDIOCODEC
	bool "Allwinner AudioCodec V2 support"
	default n
	select SUNXI_SOUND_PLATFORM_CPUDAI
	select SUNXI_SOUND_PLATFORM_PCM
	depends on (ARCH_SUN20IW2P1 || ARCH_SUN20IW2)
	help
	  Select Y to add support the Codec embedded in the Allwinner
	  sun20iw2 and affiliated SoCs.

if SUNXI_SOUND_CODEC_SUN20IW2_AUDIOCODEC
menu "Allwinner AudioCodec V2 Choose"
config SUNXI_SOUND_CODEC_AUDIOCODEC_DAC
	bool "Allwinner AudioCodec DAC V2 Support"
	default n
	select SUNXI_SOUND_COMMON_SUNXI_COMMON
	select SUNXI_SOUND_COMMON_ALG_CFG
	help
	  Select Y to add support for audiocodec dac.

config SUNXI_SOUND_CODEC_AUDIOCODEC_ADC
	bool "Allwinner AudioCodec ADC V2 Support"
	default n
	select SUNXI_SOUND_COMMON_SUNXI_COMMON
	help
	  Select Y to add support for audiocodec adc.

config SUNXI_SOUND_CODEC_AUDIOCODEC_DAC_KEEP_AUDIO_PLL_ON
	bool "keep audio pll on"
	default n
	depends on SUNXI_SOUND_CODEC_AUDIOCODEC_DAC
	help
	  Select Y to keep audio pll on during standby.

endmenu
endif

config SUNXI_SOUND_CODEC_DUMMY
	bool "Sunxi dummy codec V2"
	default n

config SUNXI_SOUND_CODEC_AC108
	bool "Sunxi AC108 codec V2"
	default n

config SUNXI_SOUND_CODEC_AC101S
	bool "Sunxi AC101S codec V2"
	default n
	select DRIVERS_TWI

endmenu
```

## lichee/rtos-hal/hal/source/sound/driver_v2/common/Kconfig
```kconfig
config SUNXI_SOUND_COMMON_SUNXI_COMMON
	bool
	default n

config SUNXI_SOUND_RXSYNC
	bool "Allwinner RX SYNC Support"
	default n

config SUNXI_SOUND_COMMON_ALG_CFG
	bool
	default n
```

## lichee/rtos-hal/hal/source/sound/driver_v2/component/Kconfig
```kconfig
menu "AW Sound Components"

choice
	prompt "Allwinner tiny sound library"
	depends on DRIVERS_SOUND_V2
	default COMPONENTS_AW_AUDIO_LIB_NONE

config COMPONENTS_AW_AUDIO_LIB_NONE
	bool "none"

config COMPONENTS_AW_TINY_SOUND_LIB
	bool "AW tiny sound driver library"
	help
	  This is library package for aw-sound-drv, only used for Allwinner FreeRTOS.

endchoice

config COMPONENTS_AW_TINY_SOUND_LIB_UTILS
	bool "AW tiny sound driver library utils"
	depends on COMPONENTS_AW_TINY_SOUND_LIB
	default n
	help
	  This is the choice of aw audio driver utils

config COMPONENTS_AW_TINY_SOUND_UTILS
	bool "AW tiny sound utils"
	depends on COMPONENTS_AW_TINY_SOUND_LIB
	default n
	help
	  This is the choice of aw audio driver utils

config COMPONENTS_AW_TINY_SOUND_UTILS_AWTINYMIXER
	bool "AW tiny sound utils aw_tinymixer"
	depends on COMPONENTS_AW_TINY_SOUND_UTILS
	default y
	help
	  This is the choice of compile aw_tinymixer

config COMPONENTS_AW_TINY_SOUND_UTILS_AWTINYPLAY
	bool "AW tiny sound utils aw_tinyplay"
	depends on COMPONENTS_AW_TINY_SOUND_UTILS
	default y
	help
	  This is the choice of compile aw_tinyplay

config COMPONENTS_AW_TINY_SOUND_UTILS_AWTINYCAP
	bool "AW tiny sound utils aw_tinycap"
	depends on COMPONENTS_AW_TINY_SOUND_UTILS
	default y
	help
	  This is the choice of compile aw_tinycap

config COMPONENTS_AW_TINY_SOUND_UTILS_AWTINYLOOP
	bool "AW tiny sound utils aw_tinyloop"
	depends on COMPONENTS_AW_TINY_SOUND_UTILS
	default n
	help
	  This is the choice of compile aw_tinyloop
endmenu
```

## lichee/rtos-hal/hal/source/sound/driver_v2/core/Kconfig
```kconfig
menu "AllWinner Audio Driver Device"

config SUNXI_SOUND_AUDIO_DRIVER_DEVICE
	bool "Allwinner Audio Driver Device support"
	default n
	help
	  Select Y to add support Allwinner Audio Driver Device.

config SUNXI_SOUND_AUDIO_DRIVER_DEVICE_CORE
	bool "Allwinner Audio Driver Device Core support"
	default y
	depends on SUNXI_SOUND_AUDIO_DRIVER_DEVICE
	help
	  Select Y to add support Allwinner Audio Driver Device Core.

config SUNXI_SOUND_AUDIO_DRIVER_CONTROL
	bool "Allwinner Audio Driver Device Control support"
	default y
	depends on SUNXI_SOUND_AUDIO_DRIVER_DEVICE_CORE
	help
	  Select Y to add support Allwinner Audio Control Driver Device.

config SUNXI_SOUND_AUDIO_DRIVER_PCM_LIB
	bool "Allwinner Audio Driver Pcm lib support"
	default y
	depends on SUNXI_SOUND_AUDIO_DRIVER_DEVICE_CORE
	help
	  Select Y to add support Allwinner Audio Pcm lib.

config SUNXI_SOUND_AUDIO_DRIVER_PCM_DMA
	bool "Allwinner Audio Driver Pcm dma support"
	default y
	depends on SUNXI_SOUND_AUDIO_DRIVER_DEVICE_CORE
	help
	  Select Y to add support Allwinner Audio Pcm dma .

config SUNXI_SOUND_AUDIO_DRIVER_PCM
	bool "Allwinner Audio Driver Pcm support"
	default y
	depends on SUNXI_SOUND_AUDIO_DRIVER_PCM_DMA && SUNXI_SOUND_AUDIO_DRIVER_PCM_LIB
	help
	  Select Y to add support Allwinner Audio Pcm  Driver.

endmenu
```

## lichee/rtos-hal/hal/source/sound/driver_v2/platform/Kconfig
```kconfig
menu "Platform(Audio Interface) drivers V2"

config SUNXI_SOUND_PLATFORM_PCM
	bool
	default n

config SUNXI_SOUND_PLATFORM_MACH
	bool
	default n

config SUNXI_SOUND_PLATFORM_CPUDAI
	bool "Allwinner internal cpudai V2"
	select SUNXI_SOUND_PLATFORM_PCM
	select SUNXI_SOUND_PLATFORM_MACH
	default n
	help
	  Only support for the Codec embedded in the Allwinner SoCs.

config SUNXI_SOUND_PLATFORM_I2S
	bool "Allwinner Digital Audio V2 Support"
	select SUNXI_SOUND_PLATFORM_PCM
	select SUNXI_SOUND_CODEC_DUMMY
	select SUNXI_SOUND_COMMON_SUNXI_COMMON
	select SUNXI_SOUND_PLATFORM_MACH
 	depends on (!ARCH_SUN8IW19)
	default n
	help
	  Select Y to add support for I2S/PCM/TDM module in Allwinner SoCs.

config SUNXI_SOUND_PLATFORM_SUN8IW19_I2S
 	bool "Allwinner Digital Audio V2 Support"
 	select SUNXI_SOUND_PLATFORM_PCM
	select SUNXI_SOUND_CODEC_DUMMY
	select SUNXI_SOUND_PLATFORM_MACH
 	depends on (ARCH_SUN8IW19P1 || ARCH_SUN8IW19)
 	default n
 	help
 	  Select Y to add support for I2S/PCM/TDM module in Allwinner SoCs.

if SUNXI_SOUND_PLATFORM_I2S || SUNXI_SOUND_PLATFORM_SUN8IW19_I2S
menu "Allwinner Digital Audio V2 Choose"
config SUNXI_SOUND_PLATFORM_I2S0
	bool "Allwinner I2S0 V2 Support"
	default n
	help
	  Select Y to add support for I2S0.

config SUNXI_SOUND_PLATFORM_I2S1
	bool "Allwinner I2S1 V2 Support"
	default n
	help
	  Select Y to add support for I2S1.

config SUNXI_SOUND_PLATFORM_I2S2
	bool "Allwinner I2S2 V2 Support"
 	depends on (!SUNXI_SOUND_PLATFORM_SUN8IW19_DAUDIO)
	default n
	help
	  Select Y to add support forI2S2.

config SUNXI_SOUND_PLATFORM_I2S3
	bool "Allwinner I2S3 V2 Support"
 	depends on (!SUNXI_SOUND_PLATFORM_SUN8IW19_DAUDIO)
	default n
	help
	  Select Y to add support for I2S3.
endmenu
endif

config SUNXI_SOUND_PLATFORM_DMIC
	bool "Allwinner DMIC V2 Support"
	select SUNXI_SOUND_PLATFORM_PCM
	select SUNXI_SOUND_CODEC_DUMMY
	select SUNXI_SOUND_COMMON_SUNXI_COMMON
	select SUNXI_SOUND_PLATFORM_MACH
	default n
	help
	  Select Y to add support for DMIC module in Allwinner SoCs.

config SUNXI_SOUND_PLATFORM_OWA
	bool "Allwinner OWA V2 Support"
	select SUNXI_SOUND_PLATFORM_PCM
	select SUNXI_SOUND_CODEC_DUMMY
	select SUNXI_SOUND_COMMON_SUNXI_COMMON
	select SUNXI_SOUND_PLATFORM_MACH
	default n
	help
	  Select Y to add support for OWA module in Allwinner SoCs.

config SUNXI_SOUND_PLATFORM_MAD
	bool "Allwinner MAD V2 Support"
	default n
	help
	  Select Y to add support for MAD module in Allwinner SoCs.

config SUNXI_SOUND_MAD_DEBUG
	bool "Allwinner MAD Debug Support"
	depends on SUNXI_SOUND_PLATFORM_MAD
	default n
	help
	  Select Y to add support for MAD debug in Allwinner SoCs.

config SUNXI_SOUND_DEBUG
	bool "Allwinner Audio Debug Support"
	default n
	help
	  Select Y to add support for audio debug in Allwinner SoCs.

endmenu
```

## lichee/rtos-hal/hal/source/spi/Kconfig
```kconfig
menu "SPI Devices"

config DRIVERS_SPI
    bool "enable spi driver"
        default n

config DRIVERS_SPI_PANIC_TRANSFER
    bool "support sp transfer if crash"
    depends on DRIVERS_SPI
        default n

config DRIVERS_SPI_DMA_MALLOC_SELF
    bool "spi dma will malloc buff"
    depends on DRIVERS_SPI
        default y

config HAL_TEST_SPI
    bool "enable spi hal APIs test command"
    depends on DRIVERS_SPI
        default n

endmenu
```
