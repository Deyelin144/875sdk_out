## lichee/rtos/projects/r528s3/evb3/Kconfig
```kconfig
if PROJECT_R528S3_EVB3_DEMO

config PROJECT_DEMO_TEST_QUEUE
    bool "test freertos queue send and recv function"
    default n

endif
```

## lichee/rtos/projects/xr875s1h10/solution_m33/Kconfig
```kconfig
config PROJECT_BUILD_RECOVERY
    bool "build ota recovery"
    default n

config DSP_USE_EXTIO_DCDC_EN_IO
    bool "use external extio DCDC en IO"
    default n
```
