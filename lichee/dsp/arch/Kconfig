## lichee/dsp/arch/Kconfig
```kconfig
choice
	prompt "Target SoC platform"
	default ARCH_SUNXXIWX

config ARCH_SUN20IW2
	bool "sun20iw2"
	select XTENSA_HIFI5

config ARCH_SUNXXIWX
	bool "sunXXiwX"

endchoice

# define arch
config ARCH_DSP
	bool
	default y

config XTENSA_HIFI5
bool
	depends on ARCH_SUN20IW2
	default n

# define include arch dir
config ARCH_PLATFORM
	string
	default "sun20iw2" if ARCH_SUN20IW2

# define the development board
choice
	prompt "Development boards"
	default PRO_PLATFORM

config FPGA_PLATFORM
	bool "FPGA board"

config PRO_PLATFORM
	bool "PRO board"

endchoice

# define DSP core
choice
	prompt "Select DSP core"
	default CORE_DSP0

config CORE_DSP0
	bool "Core 0"

endchoice

# define dsp core id
config CORE_ID
	string
	default "dsp0" if CORE_DSP0

source "arch/sun20iw2/Kconfig"
```

## lichee/dsp/arch/sun20iw2/Kconfig
```kconfig
config DSP_IS_POWERED_BY_INTERNAL_LDO
	bool "dsp is powered by internal lod"
	default n
	help
		Configuring the DSP_LDO at a voltage suitable for DSP.

config DEFAULT_DSP_CORE_CLK_FREQ
    int "DSP Core CPU Frequency"
    default 400000000
    range 0 400000000
    help
      Default DSP feq is set by M33 core, effect if M33 without setting.
      The default frequency is 400 MHz.
```

## lichee/dsp/components/aw/testbench/Kconfig
```kconfig
config AW_TEST_MEM
	bool "Memory test"
	default n

config AW_TEST_CACHE
	bool "Cache test"
	default n

config AW_TEST_TIMER
	bool "Timer test"
	default n

menu "dump reg option features"
config ADJUST_REG
	bool "adujst and dump some reg when suspend."
	default n

config CLOSE_SUART_PIN
	bool "close suart pins(PL8/PL9) when suspend."
	default n

endmenu

config AW_HARDWARE_PERF
	bool "HARDWARE performance"
	select DRIVERS_TIMER
	default n

menu "Performance Testing"
source "components/aw/testbench/performance/Kconfig"
endmenu

source "components/aw/testbench/vfpu_test/Kconfig"
```

## lichee/dsp/components/thirdparty/Kconfig
```kconfig
if PORT_XCC_XTENSA
menu "Xtensa components"

config COMPONENTS_XTENSA
	bool
	default y

source "components/thirdparty/xtensa/Kconfig"

endmenu
endif

if KERNEL_FREERTOS
menu "FreeRTOS components"

config COMPONENTS_FREERTOS
	bool
	default y

source "components/thirdparty/freertos/Kconfig"

endmenu
endif

config COMPONENTS_MSGBOX_DEMO
	bool "Msgbox demo"
	default n
	help
	  This is a demo that introduces how to use msgbox

config COMPONENTS_COREMARK
	bool "Coremark"
	default n

config COMPONENTS_AISPEECH_SSPE
        bool "AISPEECH SSPE"
        default n
        depends on COMPONENTS_AMP
        depends on COMPONENTS_AW_AUDIO_SYSTEM_RECORD
        select AMP_RPDATA_STUB
        select AMP_RPDATA_SERVICE
        select COMPONENTS_MD5
        select COMPONENT_CJSON
        select COMPONENTS_XTENSA_HIFI5_VFPU_LIBRARY
```

## lichee/rtos-components/aw/chatbox/Kconfig
```kconfig
config COMPONENTS_CHAT_BOX
	bool "chat box"
	select COMPONENTS_WEBSOCKET
	default n
```

## lichee/rtos-components/aw/debug/Kconfig
```kconfig
menu "command-line interface"

config COMMAND_MEMTESTER
	bool "memtester command"
    default n

endmenu
```

## lichee/rtos-components/aw/efpg/Kconfig
```kconfig
config COMPONENTS_AW_EFPG
    bool "aw_efpg"
    depends on (DRIVERS_EFUSE)
    default n
    help
        sunxi aw efpg component.
```

## lichee/rtos-components/aw/ftrace/Kconfig
```kconfig
menuconfig DYNAMIC_FTRACE
	bool "Dynamic ftrace Support."
	select DYNAMIC_FTRACE_FUNCTION
	default n
	help
	  Dynamic ftrace Support.

if DYNAMIC_FTRACE
	menu "tracer type"

	config DYNAMIC_FTRACE_FUNCTION
		bool "Enable function tracer"
		default y
	config DYNAMIC_FTRACE_GRAPH
		bool "Enable function graph tracer"
		default y
	menuconfig DYNAMIC_FTRACE_IRQSOFF
		bool "Enable irqsoff tracer"
		default n
		if DYNAMIC_FTRACE_IRQSOFF
			config DYNAMIC_FTRACE_ISR_CALL_XIPFUNC_CHECK
				bool "Enable check call xip_func in isr"
				default n
			if DYNAMIC_FTRACE_ISR_CALL_XIPFUNC_CHECK
				config FIND_MAX_INST_NUM
					int "find max inst num"
					default 500
			endif
		endif

	endmenu

config DYNAMIC_FTRACE_KALLSYMS
	bool "Enable KALLSYMS"
	default y

config DYNAMIC_FTRACE_FILTER
	bool "Enable function filter"
	default y

config MAX_BUF_SIZE
	int "log save to ringbuf, the ringbuf size."
	default 8192

config MAX_FILTER_TABLE_SIZE
	int "filter table size."
	default 64

config INIT_TASK_STACK_SIZE
	int "init task stack size."
	default 1024

config DEINIT_TASK_STACK_SIZE
	int "deinit task stack size."
	default 1024

config CMD_TASK_STACK_SIZE
	int "cmd task stack size."
	default 8192

config CMD_TASK_PRI
	int "cmd task pri."
	default 2

endif
```

## lichee/rtos-components/aw/ostest/Kconfig
```kconfig
menu "Os Testcase Support"

config COMPONENTS_OSTEST
    bool "Os Testcase"
    default n
    help
        Tina RTOS Os Testcase support.

if COMPONENTS_OSTEST

config COMPONENTS_OSTEST_JPEGPERF
    bool "JPEGPERF Testcase"
    default n

source "components/common/aw/ostest/fpu_test/Kconfig"
source "components/common/aw/ostest/kernel_test/Kconfig"
source "components/common/aw/ostest/osal_test/Kconfig"

endif

endmenu
```

## lichee/rtos-components/aw/ostest/fpu_test/Kconfig
```kconfig
menuconfig COMPONENTS_OSTEST_FPU
	bool "FPU Testcase"

if COMPONENTS_OSTEST_FPU

config FPU_GENERAL_REG_SIZE
	int "FPU General Register Size"
	default 4

config FPU_GENERAL_REG_CNT
	int "FPU General Register Count"
	default 32

config FPU_CTX_TEST
    bool "FPU Context Save/Restore Test"
    default n

config FPU_CTX_TEST_WITH_ROUNDING_MODE
	bool "FPU Context Save/Restore Test With Rounding Mode"
	default n if ARCH_ARM
	default y if ARCH_RISCV
	depends on FPU_CTX_TEST
	help
		Float point rounding mode controll the rounding rule of float point arithmetic.
		Due to this test currently depends on fegetround API and fesetround API which is
		declared in fenv.h, so we need to turn off this configuration when the system
		don't support these APIs.

config SHOW_C906_FPU_CTX_STATISTICS_INFO
    bool "Provide command to print C906 FPU context statistics info"
    depends on RECORD_C906_FPU_CTX_STATISTICS
    default n

endif
```

## lichee/rtos-components/aw/ostest/kernel_test/Kconfig
```kconfig
menuconfig COMPONENTS_OSTEST_KERNEL
	bool "Kernel Testcase"

if COMPONENTS_OSTEST_KERNEL

config OS_SCHEDULE_TEST
    bool "OS Schedule Testcase"
    default n

config OS_TICK_FREQ_TEST
    bool "OS Tick Frequency Testcase"
    default n

endif
```

## lichee/rtos-components/aw/ota_v2/Kconfig
```kconfig
menu "AW OTA Compenents version 2"

config COMPONENTS_AW_OTA_V2
    bool "Tina RTOS OTA APP VERSION 2"
    select COMPONENT_FLAG
    default n
    help
        Tina RTOS OTA support version 2.
        If unsure, say N.

if COMPONENTS_AW_OTA_V2
menu "OTA STREAM"
config COMPONENTS_AW_OTA_FILE
    bool "RTOS OTA SUPPORT FILE UPDATE"
    depends on COMPONENTS_AW_OTA_V2
    default n

config COMPONENTS_AW_OTA_HTTP
    bool "RTOS OTA SUPPORT HTTP UPDATE"
    depends on COMPONENTS_AW_OTA_V2
    select COMPONENTS_HTTPCLIENT
    default n
endmenu

config COMPONENTS_AW_OTA_ROLLBACK
    bool "SUPPORT AW OTA ROLLBACK"
    select DRIVERS_WATCHDOG
    default n

config COMPONENTS_AW_OTA_COMPOENT
    bool "SUPPORT AW OTA COMPOENT"
    select COMPONENTS_MD5
    default n

if COMPONENTS_AW_OTA_COMPOENT
    config COMPONENTS_AW_OTA_INFO_SIZE
        int "ota max info size"
        default 2048

    choice
        default COMPONENTS_AW_OTA_V2_RECOVERY
        prompt "OTA TYPE"
    config COMPONENTS_AW_OTA_V2_RECOVERY
        bool "ota recovery"
    config COMPONENTS_AW_OTA_V2_AB
        bool "ota ab"
    endchoice
endif

endif

endmenu
```

## lichee/rtos-components/aw/pm/Kconfig
```kconfig
menuconfig COMPONENTS_PM
    bool "PowerManager Support"
    default n
    help
      Support standby and hibernation mode.

if COMPONENTS_PM
choice COMPONENTS_PM_CORE
    prompt "Select core"
    default COMPONENTS_PM_CORE_M33   if ARCH_ARM_ARMV8M
    default COMPONENTS_PM_CORE_RISCV if ARCH_RISCV_RV64
    default COMPONENTS_PM_CORE_DSP   if ARCH_DSP
    help
      This option determines which core the PM run on.

    config COMPONENTS_PM_CORE_M33
        bool "M33"
        help
          the code for m33

    config COMPONENTS_PM_CORE_DSP
        bool "DSP"
        help
          the code for dsp

    config COMPONENTS_PM_CORE_RISCV
        bool "RISCV"
        help
          the code for riscv
endchoice

comment "Special Config"
config ARCH_PM_FIRMWARE_BASE
    hex "PM Firmware's space base"
    default 0x04000000
    depends on COMPONENTS_PM_CORE_M33
    help
      The space must be placed on SRAM.
      This parameter takes effect only after
      COMPONENTS_PM_CORE_M33 is enabled

config ARCH_PM_FIRMWARE_SIZE
    hex "PM Firmware's space size"
    default 0x10000
    depends on COMPONENTS_PM_CORE_M33
    help
      The recommended value is not less than 64K.

config PM_SIMULATED_RUNNING
    bool "Simulated on FPGA"
    default n
    help
      Simulates a running environment on the FPGA

config PM_SUBSYS_RISCV_SUPPORT
    bool "support riscv subsys"
    default y
    depends on COMPONENTS_PM_CORE_M33
    help
      Enable riscv subsys support

config PM_SUBSYS_DSP_SUPPORT
    bool "support dsp subsys"
    default n
    depends on COMPONENTS_PM_CORE_M33
    help
      Enable dsp subsys support

config COMPONENTS_PM_SUBSYS_TASK_SAFE
    bool "support riscv & dsp task freeze sync"
    default n
    depends on COMPONENTS_PM_CORE_RISCV || COMPONENTS_PM_CORE_DSP
    help
      Enable dsp&rv task freeze sync

config COMPONENTS_PM_TEST_TOOLS
    bool "PM test tools"
    default n
    depends on COMPONENTS_PM
    help
      Enable pm test tools, including pm stress, recording sign and etc.

config COMPONENTS_PM_DEBUG_TOOLS
    bool "PM debug tools"
    default n
    help
      Enable pm debug tools.

config COMPONENTS_PM_RECORD_GPIO
    bool "PM debug tools - record gpio"
    default n
    depends on COMPONENTS_PM_DEBUG_TOOLS && COMPONENTS_PM_CORE_M33
    help
      Enable pm record gpio tools.

config COMPONENTS_PM_RECORD_REG
    bool "PM debug tools - record reg"
    default n
    depends on COMPONENTS_PM_DEBUG_TOOLS && COMPONENTS_PM_CORE_M33
    help
      Enable pm record register tools.

config COMPONENTS_PM_RECORD_TIME
    bool "PM debug tools - record time"
    default n
    depends on COMPONENTS_PM_DEBUG_TOOLS
    help
      Enable pm record time tools.

config COMPONENTS_PM_WATCHDOG
    bool "PM debug tools - watchdog"
    default n
    depends on COMPONENTS_PM_DEBUG_TOOLS
    help
      Enable pm watchdog tools.
endif
```

## lichee/rtos-components/aw/tinatest/testcase/os/Kconfig
```kconfig
config TESTCASE_OS
	bool "OS Testcase."
	default n
	depends on OS_SCHEDULE_TEST || OS_TICK_FREQ_TEST || FPU_CTX_TEST
	help
	  This testcase used test os kernel API.
```

## lichee/rtos-components/aw/tinatest/testcase/osal/Kconfig
```kconfig
config TESTCASE_OSAL
	bool "OSAL Testcase."
	default n
	depends on COMPONENTS_OSTEST_OSAL_TIME || COMPONENTS_OSTEST_OSAL_TIMER || \
	COMPONENTS_OSTEST_OSAL_THREAD || COMPONENTS_OSTEST_OSAL_QUEUE || \
	COMPONENTS_OSTEST_OSAL_SEM || COMPONENTS_OSTEST_OSAL_WAITQUEUE || \
	COMPONENTS_OSTEST_OSAL_WORKQUEUE
	help
	  This testcase used test osal API.
```

## lichee/rtos-components/aw/usb/gadget/hidd/Kconfig
```kconfig
config COMPONENTS_USB_GADGET_HIDD
    bool "hidd service"
    select DRIVERS_USB_UDC
    default n
    help
	  hidd service
```

## lichee/rtos-components/thirdparty/Kconfig
```kconfig
source components/common/thirdparty/md5/Kconfig
source components/common/thirdparty/littlevgl-8/Kconfig
source components/common/thirdparty/cjson/Kconfig
source components/common/thirdparty/coremark/Kconfig
source components/common/thirdparty/dhrystone/Kconfig
source components/common/thirdparty/whetstone/Kconfig
source components/common/thirdparty/opus/Kconfig
source components/common/thirdparty/network/Kconfig
source components/common/thirdparty/bluetooth/Kconfig
source components/common/thirdparty/linpack/Kconfig
source components/common/thirdparty/pi_css5_src/Kconfig
source components/common/thirdparty/freetype/Kconfig
source components/common/thirdparty/speexdsp/Kconfig
source components/common/thirdparty/libjpeg-turbo/Kconfig
source components/common/thirdparty/giflib/Kconfig
source components/common/thirdparty/sonic/Kconfig
source components/common/thirdparty/openh264/Kconfig
source components/common/thirdparty/webrtc/Kconfig
source components/common/thirdparty/xvid/Kconfig
```

## lichee/rtos-components/thirdparty/libjpeg-turbo/Kconfig
```kconfig
menuconfig COMPONENTS_LIBJPEG_TURBO
	bool "libjpeg-turbo"
	default n

if COMPONENTS_LIBJPEG_TURBO

config LIBJPEG_CJPEG
	bool "libjpeg code command cjpeg"
 	default n
		help
		support cjpeg command

config LIBJPEG_DJPEG
	bool "libjpeg decode command djpeg"
	default n
		help
		support djepg command

config LIBJPEG_TEST_DEMO
	bool "libjpeg test demo jpeg_test"
	default n
		help
		libjpeg-turbo test demo - jpeg_test

if LIBJPEG_TEST_DEMO
config RPDATA_JPEG_LOOP_TIMES
       default "10"
       string "loop times"
       help
               This means how many rpdata jpg test times need to be tested.

endif

endif
```
